AUTOSAR XML (schema 4-0-3)
package /COM/VECTOR/CFG/WORKFLOW/SYSDESC/SYNC
  flat map FLATMAP
    41 x flat instance descriptor:
      RPortPrototype_001: upstream-reference=PpHighBeamSwitchReceive, ecu-extract-reference=PpHighBeamSwitchReceive
      ComponentPrototype: upstream-reference=ECU_Composition.CpCoApplication.CpSaSteeringWheel, ecu-extract-reference=COMPOSITIONTYPE.CpSaSteeringWheel
      ComponentPrototype_001: upstream-reference=ECU_Composition.CpCoApplication.CpSaLeftFrontlight, ecu-extract-reference=COMPOSITIONTYPE.CpSaLeftFrontlight
      ComponentPrototype_002: upstream-reference=ECU_Composition.CpCoApplication.CpCddIoHwAb, ecu-extract-reference=COMPOSITIONTYPE.CpCddIoHwAb
      ComponentPrototype_003: upstream-reference=ECU_Composition.CpCoApplication.CpApAFSController, ecu-extract-reference=COMPOSITIONTYPE.CpApAFSController
      AssemblySwConnector: ecu-extract-reference=CpApAVHControllerDPpLightPositionDCpSaHeadlightDPpLightPosition
      ComponentPrototype_004: upstream-reference=ECU_Composition.CpCoApplication.CpSaRightFrontlight, ecu-extract-reference=COMPOSITIONTYPE.CpSaRightFrontlight
      AssemblySwConnector_003: ecu-extract-reference=CpApAFSControllerDPpLightPositionRightDCtSaRightHeadlightDPpLightPosition
      RPortPrototype_002: upstream-reference=PpSteeringWheelPosition, ecu-extract-reference=PpSteeringWheelPosition
      DelegationSwConnector: ecu-extract-reference=PpSteeringWheelPosition_1DDCpCoApplicationDPpSteeringWheelPosition
      DataMapping: upstream-reference=ECU_Composition.PpSteeringWheelPosition.DeSteeringWheelPosition, ecu-extract-reference=COMPOSITIONTYPE.PpSteeringWheelPosition.DeSteeringWheelPosition
      RPortPrototype: upstream-reference=PpSteeringWheelPosition, ecu-extract-reference=PpSteeringWheelPosition
      DelegationSwConnector_001: ecu-extract-reference=PpRightLightPositionOutDDCtSaRightHeadlightDPpLightPositionOut
      DelegationSwConnector_002: ecu-extract-reference=PpLeftLightPositionOutDDCpSaLeftHeadlightDPpLightPositionOut
      DataMapping_001: upstream-reference=ECU_Composition.PpRightLightPositionOut.DeLightPosition, ecu-extract-reference=COMPOSITIONTYPE.PpRightLightPositionOut.DeLightPosition
      DataMapping_002: upstream-reference=ECU_Composition.PpLeftLightPositionOut.DeLightPosition, ecu-extract-reference=COMPOSITIONTYPE.PpLeftLightPositionOut.DeLightPosition
      AssemblySwConnector_001: ecu-extract-reference=CpSaSteeringWheelDPpSteeringWheelPositionOutDCpApAFSControllerDPpSteeringWheelPosition
      AssemblySwConnector_002: ecu-extract-reference=CpCddIoHwAbDPpAFSSwitchDCpApAFSControllerDPpAFSSwitch
      AssemblySwConnector_004: ecu-extract-reference=CpCddIoHwAbDPpHighBeamDCpApAFSControllerDPpHighBeam
      DataMapping_006: upstream-reference=ECU_Composition.PpAmbientLightIn.DeAmbientLight, ecu-extract-reference=COMPOSITIONTYPE.PpAmbientLightIn.DeAmbientLight
      DataMapping_007: upstream-reference=ECU_Composition.PpVehicleSpeedIn.DeVehicleSpeed, ecu-extract-reference=COMPOSITIONTYPE.PpVehicleSpeedIn.DeVehicleSpeed
      PPortPrototype: upstream-reference=PpLeftLightPositionOut, ecu-extract-reference=PpLeftLightPositionOut
      PPortPrototype_001: upstream-reference=PpRightLightPositionOut, ecu-extract-reference=PpRightLightPositionOut
      DataMapping_003: upstream-reference=ECU_Composition.PpLeftLightPositionOut.DeLightLength, ecu-extract-reference=COMPOSITIONTYPE.PpLeftLightPositionOut.DeLightLength
      DataMapping_004: upstream-reference=ECU_Composition.PpRightLightPositionOut.DeLightLength, ecu-extract-reference=COMPOSITIONTYPE.PpRightLightPositionOut.DeLightLength
      RPortPrototype_003: upstream-reference=PpAmbientLightBrightnessIn, ecu-extract-reference=PpAmbientLightBrightnessIn
      RPortPrototype_005: upstream-reference=PpSpeedometerValueIn, ecu-extract-reference=PpSpeedometerValueIn
      ComponentPrototype_005: upstream-reference=ECU_Composition.CpCoApplication.CpSaSpeedometer, ecu-extract-reference=COMPOSITIONTYPE.CpSaSpeedometer
      ComponentPrototype_006: upstream-reference=ECU_Composition.CpCoApplication.CpSaAmbientLight, ecu-extract-reference=COMPOSITIONTYPE.CpSaAmbientLight
      ComponentPrototype_007: upstream-reference=ECU_Composition.CpCoApplication.CpApBatteryManager, ecu-extract-reference=COMPOSITIONTYPE.CpApBatteryManager
      AssemblySwConnector_006: ecu-extract-reference=CpSaAmbientLightDPpAmbientLightBrightnessOutDCpApAFSControllerDPpAmbientLightBrightnessIn
      AssemblySwConnector_007: ecu-extract-reference=CpSaSpeedometerDPpSpeedometerValueOutDCpApAFSControllerDPpSpeedometerValueIn
      DelegationSwConnector_003: ecu-extract-reference=PpSpeedometerValueInDDCpCoApplicationDPpSpeedometerValueIn
      DelegationSwConnector_005: ecu-extract-reference=PpAmbientLightBrightnessInDDCpCoApplicationDPpAmbientLightBrightnessIn
      DataMapping_005: upstream-reference=ECU_Composition.PpAmbientLightBrightnessIn.DeAmbientLightBrightness, ecu-extract-reference=COMPOSITIONTYPE.PpAmbientLightBrightnessIn.DeAmbientLightBrightness
      DataMapping_008: upstream-reference=ECU_Composition.PpSpeedometerValueIn.DeSpeedometerValue, ecu-extract-reference=COMPOSITIONTYPE.PpSpeedometerValueIn.DeSpeedometerValue
      AssemblySwConnector_008: ecu-extract-reference=CpCddIoHwAbDPiBatterLevelDCpApBatteryManagerDPpBatterLevelIn
      AssemblySwConnector_005: ecu-extract-reference=CpApBatteryManagerDPpBatteryModeDCpApAFSControllerDPpBatterModeIn
      AssemblySwConnector_009: ecu-extract-reference=CpApAFSControllerDPpBatteryModeOutDCpSaAmbientLightDPpBatterModeIn
      AssemblySwConnector_010: ecu-extract-reference=CpApAFSControllerDPpBatteryModeOutDCpSaSpeedometerDPpBatterModeIn
      AssemblySwConnector_011: ecu-extract-reference=CpApAFSControllerDPpBatteryModeOutDCpSaSteeringWheelDPpBatterModeIn
