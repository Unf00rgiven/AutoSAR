AUTOSAR XML (schema 4-2-1)
package /Constants
  9 x constant specification:
    CAFSSwitchOff: value-spec=0
    CAngleZero: value-spec=0
    CBatteryLow: value-spec=0
    CDarkLight: value-spec=0
    CHeadlightControlInit: value-spec=fields=[HorizontalAngle:0, Mode:0]
    CHeadlightInitMode: value-spec=0
    CHighBeamSwitchOff: value-spec=0
    CInitSpeed: value-spec=0
    CSteeringWheelInitPosition: value-spec=0
